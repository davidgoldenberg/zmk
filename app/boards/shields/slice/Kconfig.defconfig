## app/boards/shields/slice/Kconfig.defconfig
```kconfig
if SHIELD_SLICE_LEFT

config ZMK_KEYBOARD_NAME
    default "Left Slice"

config ZMK_SPLIT_BLE_ROLE_CENTRAL
    default y

endif

if SHIELD_SLICE_RIGHT

config ZMK_KEYBOARD_NAME
    default "Right Slice"

endif

if SHIELD_SLICE_LEFT || SHIELD_SLICE_RIGHT

config ZMK_SPLIT
    default y

endif
```

## app/boards/shields/slice/Kconfig.shield
```kconfig
config SLICE_LEFT
    def_bool $(shields_list_contains,slice_left)

config SLICE_RIGHT
    def_bool $(shields_list_contains,slice_right)
```
